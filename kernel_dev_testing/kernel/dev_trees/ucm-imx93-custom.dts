#include "ucm-imx93.dtsi"
#include "ucm-imx93-lvds.dtsi"

/ {
	model = "CUSTOM CompuLab UCM-i.MX93 board";
	compatible = "compulab,ucm-imx93", "fsl,imx93";
};

&lpi2c3 {
	ads1115c: adc@48 {
		compatible = "adc, adc1115";
		reg=<0x48>;
	};
};
